## config/west.yml
```yaml
manifest:
  remotes:
    - name: zmkfirmware
      url-base: https://github.com/zmkfirmware
    - name: prospector
      url-base: https://github.com/t-ogura
    - name: sayu-hub
      url-base: https://github.com/sayu-hub
    # - name: badjeff    # <-- PMW3610
    #   url-base: https://github.com/badjeff
    - name: sekigon-gonnoc  # <-- PAW3222
      url-base: https://github.com/sekigon-gonnoc
    - name: caksoylar  # <-- RGB LED
      url-base: https://github.com/caksoylar  
    - name: zettaface  # <-- Input Processor Keybind
      url-base: https://github.com/zettaface
    - name: gohanda11  # <-- Threshold Temp Layer
      url-base: https://github.com/gohanda11
    - name: kot149     # <-- Scroll Snap
      url-base: https://github.com/kot149
  projects:
    - name: zmk
      remote: zmkfirmware
      revision: v0.3
      import: app/west.yml
    - name: prospector-zmk-module
      remote: prospector
      revision: v2.0.0
      path: modules/prospector-zmk-module
    # - name: zmk-pmw3610-driver
    #   remote: badjeff
    #   revision: main
    - name: zmk-driver-paw3222
      remote: sekigon-gonnoc
      revision: main
    - name: zmk-rgbled-widget
      remote: caksoylar
      revision: v0.3
    - name: zmk-input-processor-keybind
      remote: zettaface
      revision: main
    - name: zmk-input-processor-threshold-temp-layer
      remote: gohanda11
      revision: main
    - name: zmk-scroll-snap
      remote: kot149
      revision: v1
  self:
    path: config
```
